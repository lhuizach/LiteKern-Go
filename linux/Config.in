## linux/package/netsurf-lkx/Config.in
```kconfig
config BR2_PACKAGE_NETSURF_LKX
	bool "netsurf-lkx"
	depends on !BR2_STATIC_LIBS
	select BR2_PACKAGE_EXPAT
	select BR2_PACKAGE_JPEG
	select BR2_PACKAGE_LIBPNG
	select BR2_PACKAGE_FREETYPE
	select BR2_PACKAGE_LIBCURL
	select BR2_PACKAGE_OPENSSL
	select BR2_PACKAGE_OPENSSL_FORCE_LIBOPENSSL
	help
	  NetSurf, the web browser, as a LiteKern X app: its
	  framebuffer front end drawing into a LiteKern X window
	  through libnsfb's "lkx" surface (platform/nsfb_lkx.c).
	  LiteKernX-Roadmap/06, phase L6.
```
